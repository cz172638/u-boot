## arch/arm/mach-rockchip/rk3308/Kconfig
```kconfig
if ROCKCHIP_RK3308

config TARGET_EVB_RK3308
	bool "EVB_RK3308"
	select BOARD_LATE_INIT

config TARGET_ROC_RK3308_CC
	bool "Firefly roc-rk3308-cc"
	select BOARD_LATE_INIT

config ROCKCHIP_BOOT_MODE_REG
	default 0xff000500

config ROCKCHIP_STIMER_BASE
	default 0xff1b00a0

config SYS_SOC
	default "rk3308"

config ROCKCHIP_RK3308_DEBUG_JTAG
	bool "Keep RK3308 debuggable over JTAG/SWD"
	help
	  Debug aid: SPL enables the debug signals in SGRF_SOC_CON0[4:0] and
	  muxes GPIO1_C6/C7 to JTAG_TCK/JTAG_TMS (SWCLK/SWDIO), and boards
	  may claim those pins in their device tree so that U-Boot does not
	  hand them to UART2_M0 or SPI2. Both register values are the reset
	  defaults; the SGRF bits are not described in the TRM, clearing them
	  cuts off the debugger.

	  Enabled by the rk3308-debug.config fragment:
	    make rock-pi-s-rk3308_defconfig rk3308-debug.config

config TPL_LDSCRIPT
	default "arch/arm/mach-rockchip/u-boot-tpl-v8.lds"

config TPL_TEXT_BASE
	default 0xfff81000

config TPL_STACK
	default 0xfff8ff00

config TPL_SYS_MALLOC_F_LEN
	default 0x600

source "board/rockchip/evb_rk3308/Kconfig"
source "board/firefly/firefly-rk3308/Kconfig"

endif
```

## configs/am67a_beagley_ai_a53_pciboot_defconfig
```kconfig
#include <configs/am67a_beagley_ai_a53_defconfig>

CONFIG_SPL_PCI_ENDPOINT=y
CONFIG_SPL_DM_RESET=y
CONFIG_SPL_PCI_DFU=y
CONFIG_SPL_PCI_DFU_SPL_LOAD_FIT_ADDRESS=0x81000000
CONFIG_SPL_PCI_DFU_BAR_SIZE=0x800000
CONFIG_SPL_PCI_DFU_VENDOR_ID=0x104c
CONFIG_SPL_PCI_DFU_DEVICE_ID=0xb010
CONFIG_SPL_PCI_DFU_TIMEOUT_MS=10000
CONFIG_SPL_PCI_DFU_BOOT_PHASE="u-boot.img"
CONFIG_REGMAP=y
CONFIG_SPL_REGMAP=y
CONFIG_SYSCON=y
CONFIG_SPL_SYSCON=y
CONFIG_MUX_MMIO=y
CONFIG_SPL_MUX_MMIO=y
CONFIG_PCI_ENDPOINT=y
CONFIG_PCIE_CDNS_TI_EP=y
CONFIG_PHY=y
CONFIG_SPL_PHY=y
CONFIG_PHY_CADENCE_TORRENT=y
CONFIG_PHY_J721E_WIZ=y
```
