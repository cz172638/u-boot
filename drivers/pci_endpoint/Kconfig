## drivers/pci_endpoint/Kconfig
```kconfig
# SPDX-License-Identifier: GPL-2.0
#
# PCI Endpoint Support
#

menu "PCI Endpoint"

config PCI_ENDPOINT
	bool "PCI Endpoint Support"
	depends on DM
	help
	   Enable this configuration option to support configurable PCI
	   endpoints. This should be enabled if the platform has a PCI
	   controllers that can operate in endpoint mode (as a device
	   connected to PCI host or bridge).

config PCIE_CADENCE_EP
	bool "Cadence PCIe endpoint controller"
	depends on PCI_ENDPOINT
	help
	  Say Y here if you want to support the Cadence PCIe controller in
	  endpoint mode. This PCIe controller may be embedded into many
	  different vendors SoCs.

config PCIE_CDNS_TI_EP
	bool "TI K3 PCIe EP support"
	help
	  Say Y here to enable support for the Canence PCIe Controller
	  in Endpoint Mode on TI's K3 Socs.

config PCIE_CDNS_ROCKCHIP_EP
	bool "Rockchip RK3399 PCIe endpoint controller"
	depends on PCI_ENDPOINT
	depends on ARCH_ROCKCHIP
	select PCIE_CADENCE_EP
	help
	  Say Y here to enable support for the Rockchip RK3399 PCIe
	  controller in endpoint mode. The RK3399 SoC has a PCIe
	  controller based on the Cadence PCIe core IP.
	  This controller can operate in either Root Complex or
	  Endpoint mode (mutually exclusive). Enable this option
	  to use the controller as a PCIe endpoint device.

config PCI_SANDBOX_EP
	bool "Sandbox PCIe endpoint controller"
	depends on PCI_ENDPOINT
	help
	  Say Y here if you want to support the Sandbox PCIe controller in
	  endpoint mode.
	  The sandbox driver act as a dummy driver which stores and
	  retrieves PCIe endpoint configuration as is.

endmenu
```
